## SDK/cloudcard/examples/flowplay/Kconfig
```kconfig
#
# For a description of the syntax of this configuration file,
# see the file kconfig-language.txt in the NuttX tools repository.
#

config EXAMPLES_FLOWPLAY
	bool "\"flow play for nxplayer!\" example"
	default n
	---help---
		Enable the \"flow play!\" example

if EXAMPLES_FLOWPLAY

config EXAMPLES_FLOWPLAY_PROGNAME
	string "Program name"
	default "flowplay"
	depends on BUILD_KERNEL
	---help---
		This is the name of the program that will be use when the NSH ELF
		program is installed.

endif
```

## SDK/cloudcard/examples/i2ctest/Kconfig
```kconfig
#
# For a description of the syntax of this configuration file,
# see the file kconfig-language.txt in the NuttX tools repository.
#

config EXAMPLES_I2CTEST
	bool "\"i2c test!\" example"
	default n
	---help---
		Enable the \"i2c test\" example
```

## SDK/cloudcard/examples/i2stest/Kconfig
```kconfig
#
# For a description of the syntax of this configuration file,
# see the file kconfig-language.txt in the NuttX tools repository.
#

config EXAMPLES_I2STEST
	bool "\"i2s test\" example"
	default n
	depends on AUDIO_DEVICES
	---help---
		Enable the \"i2s test\" example
```

## SDK/cloudcard/examples/iperf/Kconfig
```kconfig
config EXAMPLES_IPERF
        bool "iperf example"
        default n
        depends on NET_TCP
        ---help---
                Enable the libiuvtester example
#if EXAMPLES_IPERF
#config EXAMPLES_IPERF_PROGNAME
#    string "Proram name"
#    default "iperf"
#    depends on BUILD_KERNEL
#    ---help---
#        This is the name of the program that will be use when the NSH ELF
#        program is installed.
#endif
```

## SDK/cloudcard/examples/rtctest/Kconfig
```kconfig
#
# For a description of the syntax of this configuration file,
# see the file kconfig-language.txt in the NuttX tools repository.
#

config EXAMPLES_RTCTEST
	bool "rtc test"
	default y
	---help---
	Enable id.tfs test

if EXAMPLES_RTCTEST
config EXAMPLES_RTCTEST_PROGNAME
	string "Proram name"
	default "rtctest"
	depends on BUILD_KERNEL
	---help---
	This is the name of the program that will be use when the NSH ELF
	program is installed.
endif
```

## SDK/cloudcard/examples/uarttest/Kconfig
```kconfig
#
# For a description of the syntax of this configuration file,
# see the file kconfig-language.txt in the NuttX tools repository.
#

config EXAMPLES_UARTTEST
	bool "\"uart test!\" example"
	default n
	---help---
		Enable the \"uart test\" example

if EXAMPLES_UARTTEST

config EXAMPLES_UARTTEST_PROGNAME
	string "Program name"
	default "uarttest"
	depends on BUILD_KERNEL
	---help---
		This is the name of the program that will be use when the NSH ELF
		program is installed.

endif
```

## SDK/src/sl_ui/Kconfig
```kconfig
#
# For a description of the syntax of this configuration file,
# see the file kconfig-language.txt in the NuttX tools repository.
#

config UI
	bool "Silan UI"
	default n
	---help---
		Enable support UI.
config FLASH_4M
	bool "4M flash"
	---help---
		Use 4M flash.
```
